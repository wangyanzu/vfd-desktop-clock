// Generated by scripts/embed_web.py; edit web/ source files instead.
#pragma once
namespace clockapp::web {
inline constexpr char index[] = R"VFDWEB(<!doctype html>
<html lang="zh-CN">
<head><meta charset="utf-8"><meta name="viewport" content="width=device-width,initial-scale=1"><meta name="color-scheme" content="dark"><title>VFD · 桌面时钟</title><link rel="stylesheet" href="/style.css"><script src="/app.js" defer></script></head>
<body>
<main>
  <header><a class="brand" href="/">VFD<span>DESKTOP CLOCK / 01</span></a><span class="tag">设备设置</span></header>
  <section class="overview" aria-labelledby="title">
    <div class="intro"><p class="eyebrow">YOUR EVERYDAY INSTRUMENT</p><h1 id="title">把时间，<br>调到刚刚好。</h1><p class="description">连接网络，选择舒适的亮度。<br>设置保存在时钟里，重启后依然生效。</p><p id="connection" class="connection" role="status">正在读取设备状态…</p></div>
    <div class="instrument" aria-label="设备实时状态"><div class="instrument-top"><span>LIVE / DEVICE</span><span id="network-label">读取中</span></div><p id="clock" class="clock">--:--:--</p><div class="readings"><span>室内温度 <strong id="temperature">—</strong></span><span>湿度 <strong id="humidity">—</strong></span></div><p id="sensor-note" class="instrument-note">室内 · AHT10 传感器</p><div class="instrument-bottom"><span id="address">IP —</span><span id="uptime">运行 —</span></div></div>
  </section>
  <section class="message-panel" aria-labelledby="messages-title"><div><p class="eyebrow">INBOX / DEVICE</p><h2 id="messages-title">消息收件箱</h2><p id="mqtt-status" role="status">正在读取消息状态…</p><small id="message-status">等待设备响应</small><p class="instrument-note">短按 GPIO3 确认当前消息。普通：15 秒 / 3 遍；重要：60 秒 / 12 遍；严重：持续显示直到确认。</p></div><div class="message-actions"><button type="button" id="ack-message" disabled>确认屏幕当前消息</button><p id="ack-result" role="status" aria-live="polite"></p></div></section>
  <form id="settings" autocomplete="off">
    <fieldset id="fields" disabled><legend class="sr-only">时钟设置</legend>
      <section class="setting-section" aria-labelledby="network-title"><div class="section-heading"><span class="number">01</span><div><h2 id="network-title">连接网络</h2><p>使用 2.4 GHz Wi-Fi。更换网络后，连接可能短暂中断。</p></div></div>
        <div class="inputs"><div class="field"><label for="ssid">Wi-Fi 名称</label><input id="ssid" name="ssid" maxlength="32" required autocomplete="off" placeholder="输入网络名称"><small>最多 32 字节，中文通常每字占 3 字节。</small></div><div class="field"><label for="password-mode">密码操作</label><select id="password-mode" name="password_mode"><option value="replace">填写新密码</option><option value="keep">保留已保存的密码</option><option value="open">连接无密码的开放网络</option></select></div><div class="field wide" id="password-field"><label for="password">Wi-Fi 密码</label><div class="password-input"><input id="password" type="password" name="password" maxlength="64" autocomplete="new-password"><button type="button" id="toggle-password" aria-controls="password" aria-pressed="false">显示</button></div><small>8–63 个 ASCII 字符，或 64 位十六进制密钥。保存后不回显。</small></div></div>
      </section>
      <section class="setting-section" aria-labelledby="display-title"><div class="section-heading"><span class="number">02</span><div><h2 id="display-title">显示与时间</h2><p>上电 / 唤醒时 100% 高亮，60 秒后调暗，默认 60 分钟后自动休眠，可在下方调整。按钮可唤醒；校时设置自动应用。</p></div></div>
        <div class="inputs"><div class="field"><label for="brightness">60 秒后的常态亮度</label><select id="brightness" name="brightness"><option value="1">25% · 柔和</option><option value="2">50% · 日常</option><option value="3">75% · 明亮</option></select></div><div class="field"><label for="sleep">自动休眠</label><select id="sleep" name="sleep"><option value="15">15 分钟</option><option value="30">30 分钟</option><option value="60" selected>1 小时 · 默认</option><option value="120">2 小时</option><option value="180">3 小时</option><option value="240">4 小时</option><option value="300">5 小时</option><option value="360">6 小时</option><option value="420">7 小时</option><option value="480">8 小时</option><option value="540">9 小时</option><option value="0">永不自动休眠</option></select><small>从上电或唤醒开始计时，GPIO3 仍可手动休眠及唤醒。</small></div><div class="field"><label for="offset">UTC 偏移（分钟）</label><input id="offset" name="offset" type="number" min="-720" max="840" step="1" value="480" required><small>中国标准时间为 480；UTC 为 0，不自动切换夏令时。</small></div><div class="field wide"><label for="ntp">网络校时服务器</label><input id="ntp" name="ntp" maxlength="63" value="ntp.aliyun.com" required spellcheck="false" autocapitalize="none"><small>填写主机名或 IPv4 地址，例如 ntp.aliyun.com。</small></div></div>
      </section>
      <div class="save-bar"><p id="result" role="status" aria-live="polite">所有设置仅保存在这台设备。</p><button class="primary" type="submit" id="save">保存并应用 <span aria-hidden="true">↗</span></button></div>
    </fieldset>
  </form>

  <form id="mqtt-settings" autocomplete="off">
    <fieldset id="mqtt-fields" disabled><legend class="sr-only">消息服务设置</legend>
      <section class="setting-section" aria-labelledby="mqtt-title"><div class="section-heading"><span class="number">03</span><div><h2 id="mqtt-title">消息连接</h2><p>设置消息来源。保存后自动重连，收件箱中已有消息继续保留。</p></div></div>
        <div class="inputs">
          <div class="field"><label for="mqtt-enabled">MQTT 服务</label><select id="mqtt-enabled"><option value="0">关闭</option><option value="1">启用</option></select></div>
          <div class="field"><label for="mqtt-tls">连接加密</label><select id="mqtt-tls"><option value="1">TLS · 校验证书</option><option value="0">明文 TCP</option></select><small>TLS 需要有效时间，不会自动降级。</small></div>
          <div class="field"><label for="mqtt-host">服务器</label><input id="mqtt-host" maxlength="63" required spellcheck="false" autocapitalize="none" value="bemfa.com"></div>
          <div class="field"><label for="mqtt-port">端口</label><input id="mqtt-port" type="number" min="1" max="65535" step="1" value="9503" required><small>巴法云：TLS 9503，明文 9501。</small></div>
          <div class="field wide"><label for="mqtt-topic">订阅主题</label><input id="mqtt-topic" maxlength="64" spellcheck="false" autocapitalize="none"><small>精确主题，最多 64 字节，不支持 + / # 通配符。</small></div>
          <div class="field wide"><label for="mqtt-username">用户名（可留空）</label><input id="mqtt-username" maxlength="64" spellcheck="false" autocapitalize="none"><small>巴法云使用私钥作 ClientID 时，用户名和密码可留空。</small></div>
          <div class="field"><label for="mqtt-client-id-mode">ClientID / 巴法云私钥操作</label><select id="mqtt-client-id-mode"><option value="keep">保留已保存值</option><option value="replace">填写新值</option><option value="clear">清除</option></select><small id="mqtt-client-id-note">读取中</small></div>
          <div class="field" id="mqtt-client-id-field"><label for="mqtt-client-id">ClientID / 巴法云私钥</label><input id="mqtt-client-id" type="password" maxlength="64" autocomplete="new-password"><small>最多 64 字节，保存后不回显。</small></div>
          <div class="field"><label for="mqtt-password-mode">认证密码操作</label><select id="mqtt-password-mode"><option value="keep">保留已保存值</option><option value="replace">填写新值</option><option value="clear">清除</option></select><small id="mqtt-password-note">读取中</small></div>
          <div class="field" id="mqtt-password-field"><label for="mqtt-password">认证密码</label><input id="mqtt-password" type="password" maxlength="64" autocomplete="new-password"><small>最多 64 字节，保存后不回显。</small></div>
          <small class="wide">更换服务器、端口或加密方式时，请重新填写或明确清除旧凭据。</small>
        </div>
      </section>
      <div class="save-bar"><p id="mqtt-result" role="status" aria-live="polite">仅保存消息连接配置，不改变 Wi-Fi 与时间设置。</p><button class="primary" type="submit" id="mqtt-save">保存消息设置 <span aria-hidden="true">↗</span></button></div>
    </fieldset>
  </form>
  <form id="rotation-settings" autocomplete="off">
    <fieldset id="rotation-fields" disabled><legend class="sr-only">内容轮播设置</legend>
      <section class="setting-section" aria-labelledby="rotation-title"><div class="section-heading"><span class="number">04</span><div><h2 id="rotation-title">内容轮播</h2><p>时间保持在第一行。第二行依次展示所选内容，消息、配网和睡眠期间暂停。</p></div></div>
        <div class="inputs">
          <div class="field wide"><p class="field-label" id="rotation-pages-label">显示内容</p><div class="page-options" role="group" aria-labelledby="rotation-pages-label">
            <label class="page-option" for="page-indoor"><input type="checkbox" id="page-indoor" value="2"><span>室内温湿度<small>IN:24.6C RH:51.2%</small></span></label>
            <label class="page-option" for="page-temperature"><input type="checkbox" id="page-temperature" value="4"><span>独立温度<small>TEMP: 24.6C</small></span></label>
            <label class="page-option" for="page-humidity"><input type="checkbox" id="page-humidity" value="8"><span>独立湿度<small>HUMIDITY: 51.2%</small></span></label>
            <label class="page-option" for="page-outdoor"><input type="checkbox" id="page-outdoor" value="16"><span>室外天气<small>OUT:18.0C CLOUDY</small></span></label>
            <label class="page-option" for="page-comparison"><input type="checkbox" id="page-comparison" value="32"><span>室内外对比<small>IN:25.6 OUT:18.0C</small></span></label>
          </div><small>至少选择一项，按上方顺序展示；只选一项时固定显示。示例用于说明版式，实机显示传感器读数。</small></div>
          <div class="field"><label for="rotation-hold">每页停留（秒）</label><input id="rotation-hold" type="number" min="5" max="120" step="1" value="8" required><small>5–120 秒，从页面完整显示后开始计时。</small></div>
          <div class="field"><p class="field-label">当前轮播</p><p id="rotation-status" role="status">正在读取设置…</p><small>消息确认或唤醒后，当前页重新获得完整停留时间。</small></div>
        </div>
      </section>
      <div class="save-bar"><p id="rotation-result" role="status" aria-live="polite">轮播设置独立保存，重启后保留。</p><button class="primary" type="submit" id="rotation-save">保存轮播设置 <span aria-hidden="true">↗</span></button></div>
    </fieldset>
  </form>
  <section class="weather-overview" aria-labelledby="comparison-title">
    <p class="eyebrow">INDOOR / OUTDOOR</p><h2 id="comparison-title">室内外，一眼看清</h2>
    <div class="comparison-grid"><div><span>IN · 传感器</span><strong id="indoor-comparison">—</strong><small id="indoor-comparison-humidity">湿度 —</small></div><div><span>OUT · 天气接口</span><strong id="outdoor-temperature">—</strong><small id="outdoor-comparison-humidity">湿度 —</small></div></div>
    <p id="weather-status" role="status">天气未配置</p><p id="weather-observation">等待天气数据</p><small>并列显示室内外实测与天气数据；旧数据会标记，室内外湿度缺失时分别显示不可用。</small>
  </section>
  <form id="weather-settings"><fieldset id="weather-fields" disabled>
    <section class="setting-section" aria-labelledby="weather-title"><div class="section-heading"><span class="number">05</span><div><h2 id="weather-title">心知天气</h2><p>填写城市和 V3 API 公私钥，设备获取室外实况。保存后可勾选轮播中的室内外对比。</p></div></div>
      <div class="inputs">
        <div class="field"><label for="weather-enabled">天气服务</label><select id="weather-enabled"><option value="0">关闭</option><option value="1">启用</option></select></div>
        <div class="field"><label for="weather-location">城市 / 位置</label><input id="weather-location" maxlength="64" placeholder="例如 shanghai、北京或城市 ID" autocomplete="off"><small>支持城市名、拼音、城市 ID 或纬度:经度；区县名称无匹配时可用坐标，最多 64 字节。</small></div>
        <div class="field"><label for="weather-refresh">刷新间隔（分钟）</label><input id="weather-refresh" type="number" min="5" max="60" step="1" value="15" required><small>默认 15 分钟；失败后降低重试频率。</small></div>
        <div class="field"><label for="weather-public-mode">公钥操作</label><select id="weather-public-mode"><option value="keep">保留已保存值</option><option value="replace">填写新值</option><option value="clear">清除</option></select><small id="weather-public-note">尚未读取</small></div>
        <div class="field" id="weather-public-field"><label for="weather-public">公钥（uid）</label><input id="weather-public" type="password" maxlength="64" autocomplete="new-password" spellcheck="false" autocapitalize="none"></div>
        <div class="field"><label for="weather-private-mode">私钥操作</label><select id="weather-private-mode"><option value="keep">保留已保存值</option><option value="replace">填写新值</option><option value="clear">清除</option></select><small id="weather-private-note">尚未读取</small></div>
        <div class="field" id="weather-private-field"><label for="weather-private">私钥（key）</label><input id="weather-private" type="password" maxlength="64" autocomplete="new-password" spellcheck="false" autocapitalize="none"></div>
        <small class="wide">公私钥保存后不回显。设备通过 HTTPS 签名请求天气，私钥不进入天气请求网址。免费接口可能不提供室外湿度；关屏休眠时暂停获取。</small>
      </div>
    </section>
    <div class="save-bar"><p id="weather-result" role="status" aria-live="polite">天气配置独立保存，不改变 Wi-Fi、MQTT 或轮播选择。</p><button class="primary" type="submit" id="weather-save">保存天气设置 <span aria-hidden="true">↗</span></button></div>
  </fieldset></form>
  <footer><span>VFD / LUATOS CORE-ESP32-C3</span><span>本地管理 · 无需外网资源</span></footer>
</main>
</body></html>
)VFDWEB";
inline constexpr char style[] = R"VFDWEB(:root{--color-surface:#101715;--color-raised:#18231f;--color-text:#e6eee7;--color-muted:#a1b5a7;--color-primary:#9af5c0;--color-accent:#c8d685;--color-border:#34473d;--color-success:#9af5c0;--color-warning:#e9cd8e;--color-error:#ffb4a5;--space-xs:8px;--space-sm:16px;--space-md:24px;--space-lg:40px;--space-xl:72px;--type-body:"Helvetica Neue","PingFang SC",sans-serif;--type-display:"Georgia","Songti SC",serif;--type-mono:"Courier New",monospace;--shadow-inset:inset 0 0 48px #050b0880}
*{box-sizing:border-box}body{margin:0;background:var(--color-surface);color:var(--color-text);font:15px/1.6 var(--type-body)}main{max-width:1100px;margin:auto;padding:0 var(--space-lg)}header{height:106px;border-bottom:1px solid var(--color-border);display:flex;align-items:center;justify-content:space-between}.brand{font:34px/.95 var(--type-mono);font-weight:bold;letter-spacing:-2px;color:var(--color-primary);text-decoration:none}.brand span{display:block;font:10px/1.6 var(--type-mono);letter-spacing:2px;margin-top:10px;color:var(--color-muted)}.tag{font-size:12px;letter-spacing:2px;color:var(--color-muted)}.overview{display:grid;grid-template-columns:1fr 1.1fr;gap:var(--space-xl);padding:var(--space-xl) 0}.eyebrow{font:10px/1.5 var(--type-mono);letter-spacing:2px;color:var(--color-accent);margin:0 0 var(--space-md)}h1{font:clamp(32px,4.3vw,50px)/1.35 var(--type-display);font-weight:500;letter-spacing:1px;margin:0 0 var(--space-md)}.description{color:var(--color-muted);margin:0}.connection{margin:var(--space-md) 0 0;font-size:12px;color:var(--color-primary)}.instrument{position:relative;align-self:center;min-width:0;background:var(--color-raised);border:1px solid var(--color-border);border-top:3px solid var(--color-primary);padding:var(--space-md);box-shadow:var(--shadow-inset)}.instrument-top,.instrument-bottom{display:flex;justify-content:space-between;gap:12px;color:var(--color-muted);font:10px/1.5 var(--type-mono);letter-spacing:1px}.clock{margin:40px 0 24px;font:clamp(32px,5vw,56px)/1 var(--type-mono);letter-spacing:-2px;font-variant-numeric:tabular-nums;color:var(--color-primary);text-shadow:0 0 18px #9af5c030;white-space:nowrap}.readings{display:flex;gap:32px;font-size:12px;color:var(--color-muted)}.readings strong{color:var(--color-text);font:20px/1.4 var(--type-mono);margin-left:6px;font-weight:400}.instrument-note{font-size:11px;color:var(--color-muted);min-height:18px}.instrument-bottom{padding-top:var(--space-sm);border-top:1px solid var(--color-border);margin-top:var(--space-md)}fieldset{border:0;padding:0;margin:0;min-width:0}.setting-section{border-top:1px solid var(--color-border);padding:var(--space-lg) 0;display:grid;grid-template-columns:1fr 1.7fr;gap:var(--space-lg)}.section-heading{display:flex;align-items:flex-start;gap:var(--space-sm)}.number{color:var(--color-primary);font:12px/2 var(--type-mono);padding-top:4px}h2{font-size:20px;font-weight:500;letter-spacing:1px;margin:0 0 8px}.section-heading p{font-size:12px;color:var(--color-muted);max-width:210px;margin:0}.inputs{display:grid;grid-template-columns:1fr 1fr;gap:var(--space-md)}.field{min-width:0}.wide{grid-column:1/-1}label{display:block;font-size:13px;margin-bottom:10px}input,select{width:100%;min-width:0;border:1px solid var(--color-border);border-radius:2px;background:#0c120f;color:var(--color-text);padding:12px;font:14px/1.4 var(--type-body);min-height:46px;transition:border-color .18s cubic-bezier(.2,.7,.2,1)}input:focus,select:focus{outline:2px solid var(--color-primary);outline-offset:3px;border-color:var(--color-primary)}small{display:block;font-size:11px;color:var(--color-muted);margin-top:9px;line-height:1.6}.password-input{display:flex}.password-input input{border-radius:2px 0 0 2px}.password-input button{border:1px solid var(--color-border);border-left:0;color:var(--color-muted);background:var(--color-raised);min-width:64px;cursor:pointer}button{font-family:var(--type-body)}button:focus-visible,a:focus-visible{outline:2px solid var(--color-primary);outline-offset:4px}.save-bar{display:flex;align-items:center;justify-content:space-between;gap:var(--space-md);border-top:1px solid var(--color-border);padding:var(--space-md) 0 var(--space-lg)}#result,#mqtt-result,#rotation-result{font-size:12px;color:var(--color-muted);max-width:620px;margin:0}#result.error,#mqtt-result.error,#rotation-result.error{color:var(--color-error)}#result.success,#mqtt-result.success,#rotation-result.success{color:var(--color-success)}.primary{flex-shrink:0;border:0;border-radius:2px;background:var(--color-primary);color:#10251a;padding:15px 24px;font-size:14px;font-weight:600;cursor:pointer;display:flex;align-items:center;gap:36px;transition:background .18s cubic-bezier(.2,.7,.2,1)}.primary:hover{background:#bbffd4}.primary:disabled{opacity:.5;cursor:wait}fieldset:disabled .inputs{opacity:.5}footer{border-top:1px solid var(--color-border);padding:24px 0 40px;display:flex;justify-content:space-between;gap:16px;color:var(--color-muted);font:10px/1.6 var(--type-mono);letter-spacing:1px}[hidden]{display:none!important}.sr-only{position:absolute;width:1px;height:1px;padding:0;margin:-1px;overflow:hidden;clip:rect(0,0,0,0);white-space:nowrap;border:0}
@media(max-width:740px){main{padding:0 24px}header{height:90px}.overview{gap:32px;padding:40px 0;grid-template-columns:1fr}.intro h1 br{display:none}h1{font-size:32px}.description br{display:none}.instrument{width:100%}.clock{font-size:clamp(32px,10vw,54px);margin-top:32px}.setting-section{grid-template-columns:1fr;gap:24px;padding:32px 0}.section-heading p{max-width:none}.inputs{gap:20px}.save-bar{align-items:stretch;flex-direction:column}.primary{justify-content:space-between}.instrument-bottom{letter-spacing:0}footer{flex-direction:column;gap:8px}.readings{gap:24px}}
@media(max-width:380px){main{padding:0 16px}.inputs{grid-template-columns:1fr}.wide{grid-column:auto}.instrument{padding:20px}.readings{gap:16px}.readings strong{font-size:18px}}

.message-panel{border-top:1px solid var(--color-border);padding:var(--space-lg) 0;display:flex;justify-content:space-between;gap:var(--space-md)}.message-panel .eyebrow{margin-bottom:12px}.message-panel p{font-size:12px;color:var(--color-muted);margin:8px 0}.message-actions{align-self:center;max-width:360px}.message-actions button{background:var(--color-raised);color:var(--color-primary);border:1px solid var(--color-border);border-radius:2px;padding:12px 18px;font-size:13px;cursor:pointer}.message-actions button:disabled{opacity:.45;cursor:default}#ack-result.error{color:var(--color-error)}@media(max-width:740px){.message-panel{flex-direction:column}.message-actions{align-self:flex-start}}

.field-label{font-size:13px;margin:0 0 10px}.page-options{display:grid;grid-template-columns:1fr 1fr;gap:var(--space-sm)}.page-option{display:flex;align-items:flex-start;gap:12px;margin:0;padding:var(--space-sm);border:1px solid var(--color-border);background:var(--color-raised);cursor:pointer}.page-option input{width:18px;min-height:18px;height:18px;flex:0 0 18px;margin:3px 0 0;accent-color:var(--color-primary)}.page-option small{font-family:var(--type-mono);margin-top:4px}.page-option:has(input:checked){border-color:var(--color-primary)}#rotation-status{font-size:13px;color:var(--color-primary);margin:0}@media(max-width:540px){.page-options{grid-template-columns:1fr}}
.weather-overview{border-top:1px solid var(--color-border);padding:var(--space-lg) 0}.comparison-grid{display:grid;grid-template-columns:repeat(2,1fr);gap:16px;margin:24px 0}.comparison-grid>div{background:var(--color-raised);border:1px solid var(--color-border);padding:20px}.comparison-grid span{display:block;color:var(--color-muted);font-size:12px}.comparison-grid strong{display:block;margin-top:12px;color:var(--color-primary);font:clamp(20px,3vw,32px)/1.3 var(--type-mono)}#weather-status,#weather-observation,#weather-result{font-size:12px;color:var(--color-muted)}#weather-result.error{color:var(--color-error)}#weather-result.success{color:var(--color-success)}@media(max-width:600px){.comparison-grid{grid-template-columns:1fr}.comparison-grid>div{display:flex;align-items:center;justify-content:space-between;gap:12px}.comparison-grid strong{margin-top:0}}
)VFDWEB";
inline constexpr char app[] = R"VFDWEB('use strict';
(() => {
  const byId = id => document.getElementById(id);
  const form = byId('settings');
  const fields = byId('fields');
  const result = byId('result');
  let csrf = '', loaded = false, saving = false, messageId = 0, ackBusy = false, mqttLoaded = false, mqttSaving = false, mqttWritable = false;
  let rotationLoaded = false, rotationSaving = false, rotationWritable = false;
  const contentPages = ['indoor','temperature','humidity','outdoor','comparison'];
  let weatherLoaded = false, weatherSaving = false, weatherWritable = false;
  const notice = (text, state = '') => { result.textContent = text; result.className = state; };
  async function request(path, options = {}) {
    const controller = new AbortController();
    const timeout = setTimeout(() => controller.abort(), 8000);
    try {
      const response = await fetch(path, {credentials: 'same-origin', cache: 'no-store', ...options, signal: controller.signal});
      if (response.status === 401) throw new Error('登录已失效，请刷新页面并重新登录。');
      const data = await response.json();
      if (!response.ok) throw new Error(data.error || '设备暂时无法处理请求。');
      return data;
    } finally { clearTimeout(timeout); }
  }
  function passwordMode() {
    const replacing = byId('password-mode').value === 'replace';
    byId('password-field').hidden = !replacing;
    byId('password').required = replacing;
    byId('password').disabled = !replacing;
  }
  function mqttSecretMode(key) {
    const replacing = byId(`mqtt-${key}-mode`).value === 'replace';
    byId(`mqtt-${key}-field`).hidden = !replacing;
    byId(`mqtt-${key}`).disabled = !replacing;
    byId(`mqtt-${key}`).required = replacing;
  }
  function loadMqtt(mqtt) {
    for (const key of ['host','port','topic','username']) byId(`mqtt-${key}`).value = String(mqtt[key]);
    byId('mqtt-enabled').value = mqtt.enabled ? '1' : '0';
    byId('mqtt-tls').value = mqtt.tls ? '1' : '0';
    for (const [key, isSet] of [['client-id',mqtt.clientIdSet],['password',mqtt.passwordSet]]) {
      byId(`mqtt-${key}`).value = '';
      byId(`mqtt-${key}-mode`).value = isSet ? 'keep' : 'clear';
      byId(`mqtt-${key}-note`).textContent = isSet ? '已保存；为保护凭据，不回显。' : '尚未保存。';
      mqttSecretMode(key);
    }
    mqttLoaded = true;
  }
  function showState(state) {
    csrf = state.csrf;
    showWeather(state);
    rotationWritable = Boolean(state.storageReady);
    if (!rotationLoaded && state.rotation) {
      for (const [index, page] of contentPages.entries()) byId(`page-${page}`).checked = Boolean(state.rotation.pages & (1 << (index + 1)));
      byId('rotation-hold').value = String(state.rotation.hold);
      rotationLoaded = true;
    }
    if (!rotationSaving) byId('rotation-fields').disabled = !rotationWritable || !rotationLoaded;
    const pageLabels = {indoor:'室内温湿度',temperature:'独立温度',humidity:'独立湿度',outdoor:'室外天气',comparison:'室内外对比'};
    byId('rotation-status').textContent = `${pageLabels[state.contentPage] || '等待设备'}${state.rotationPaused ? ' · 已暂停' : ''}`;
    if (!mqttLoaded && state.mqtt) loadMqtt(state.mqtt);
    mqttWritable = Boolean(state.storageReady);
    if (!mqttSaving) byId('mqtt-fields').disabled = !state.storageReady || !mqttLoaded;
    const mqttLabels = {disabled:'MQTT 未配置', invalid:'MQTT 配置无效', waiting_wifi:'等待 Wi-Fi 连接', waiting_time:'等待校时后建立安全连接', connecting:'正在连接消息服务器', online:'消息服务已连接', retrying:'消息连接失败，稍后自动重试', unavailable:'消息服务不可用'};
    byId('mqtt-status').textContent = mqttLabels[state.mqttState] || 'MQTT 未配置';
    messageId = Number(state.messageId) || 0;
    byId('ack-message').disabled = ackBusy || !state.messageVisible || !messageId;
    const messageLevel = {1:'普通',2:'重要',3:'严重'}[state.messageLevel];
    byId('message-status').textContent = `${messageLevel ? `当前：${messageLevel} · ` : ''}未确认 ${Number(state.messageCount) || 0} 条 · 拒收 ${Number(state.messagesDropped) || 0} 条 · 淘汰旧消息 ${Number(state.messagesEvicted) || 0} 条 · 合并重复 ${Number(state.messagesDuplicate) || 0} 条`;

    byId('connection').textContent = state.connected ? '网络已连接 · 设置可随时调整' : state.setupActive ? '配网热点已开启 · 等待连接家庭网络' : '网络离线 · 时钟继续运行';
    byId('network-label').textContent = state.connected ? 'ONLINE' : 'OFFLINE';
    byId('clock').textContent = state.clock || '--:--:--';
    byId('temperature').textContent = state.temperature === null ? '—' : `${state.temperature.toFixed(1)}°C`;
    byId('humidity').textContent = state.humidity === null ? '—' : `${state.humidity.toFixed(1)}%`;
    byId('sensor-note').textContent = !state.sensorEnabled ? '温湿度传感器未启用' : state.temperature === null ? '等待 AHT10 首次有效读数' : state.sampleFresh ? 'AHT10 / 数据正常' : '读取暂不可用，显示最近有效数据';
    if (state.sensorEnabled && state.sensor && state.sensor.error) {
      const errors = {1:'I²C 写入失败',2:'状态读取失败',3:'校准失败',4:'测量忙超时',5:'测量读取失败',6:'传感器返回空测量帧',7:'测量值超范围',8:'I²C 总线恢复失败'};
      byId('sensor-note').textContent = `${errors[state.sensor.error] || '传感器读取失败'} · 连续失败 ${Number(state.sensor.consecutiveFailures) || 0} 次 · 恢复尝试 ${Number(state.sensor.recoveries) || 0} 次${state.temperature === null ? ' · 暂无有效读数' : ' · 保留最近有效数据'}`;
    }
    byId('address').textContent = `IP ${state.ip || '192.168.4.1（热点）'}`;
    const minutes = Math.floor(state.uptime / 60);
    byId('uptime').textContent = `运行 ${Math.floor(minutes / 60)}h ${minutes % 60}m`;
    if (!loaded) {
      byId('ssid').value = state.ssid;
      byId('brightness').value = String(Math.min(3, state.brightness));
      byId('sleep').value = String(state.sleepMinutes ?? 60);
      byId('offset').value = String(state.offset);
      byId('ntp').value = state.ntp;
      byId('password-mode').value = state.ssid ? 'keep' : 'replace';
      passwordMode(); loaded = true;
    }
    if (!saving) fields.disabled = !state.storageReady;
    if (!state.storageReady) notice('设备存储不可用，当前无法保存设置。', 'error');
  }
  async function poll() {
    try { showState(await request('/api/state')); }
    catch (error) {
      byId('connection').textContent = '暂时无法连接设备；切换网络后请打开设备的新地址。';
      byId('network-label').textContent = 'UNREACHABLE';
      byId('ack-message').disabled = true; messageId = 0;
      byId('sensor-note').textContent = '连接中断，显示最近读取的状态';
      byId('weather-status').textContent = '设备连接中断，天气数值为上次读取';
      if (!loaded) notice(error.message, 'error');
    } finally { setTimeout(poll, 3000); }
  }
  byId('ack-message').addEventListener('click', async () => {
    if (ackBusy || !messageId) return;
    const id = messageId;
    ackBusy = true; byId('ack-message').disabled = true; byId('ack-result').className = '';
    try {
      await request('/api/messages/ack', {method:'POST', headers:{'Content-Type':'application/x-www-form-urlencoded', 'X-CSRF-Token':csrf}, body:new URLSearchParams({id:String(id)})});
      byId('ack-result').textContent = '确认请求已提交，请以屏幕反馈和未确认数量为准。';
    } catch (error) {
      byId('ack-result').textContent = error.name === 'AbortError' ? '未收到确认结果，请等待状态刷新后再核对。' : error.message;
      byId('ack-result').className = 'error';
    } finally { ackBusy = false; }
  });
  byId('password-mode').addEventListener('change', passwordMode);
  byId('toggle-password').addEventListener('click', () => {
    const show = byId('password').type === 'password';
    byId('password').type = show ? 'text' : 'password';
    byId('toggle-password').textContent = show ? '隐藏' : '显示';
    byId('toggle-password').setAttribute('aria-pressed', String(show));
  });
  form.addEventListener('submit', async event => {
    event.preventDefault();
    if (saving || !loaded || !form.reportValidity()) return;
    if (new TextEncoder().encode(byId('ssid').value).length > 32) { notice('Wi-Fi 名称超过 32 字节，请缩短后重试。', 'error'); return; }
    const mode = byId('password-mode').value;
    const body = new URLSearchParams({ssid: byId('ssid').value, password_mode: mode,
      password: mode === 'replace' ? byId('password').value : '', brightness: byId('brightness').value,
      offset: byId('offset').value, ntp: byId('ntp').value, sleep: byId('sleep').value});
    saving = true; fields.disabled = true; byId('save').textContent = '正在保存…'; notice('正在写入设备，请稍候。');
    try {
      await request('/api/settings', {method: 'POST', headers: {'Content-Type': 'application/x-www-form-urlencoded', 'X-CSRF-Token': csrf}, body});
      byId('password').value = ''; byId('password-mode').value = 'keep'; passwordMode();
      notice('已保存。若更换了网络，设备正在尝试连接；连接失败后会重新开放配网热点。', 'success');
    } catch (error) {
      notice(error.name === 'AbortError' ? '未收到保存结果。请重新连接设备并刷新页面，核对配置后再操作。' : error.message, 'error');
    } finally {
      saving = false; fields.disabled = false; byId('save').textContent = '保存并应用 ↗';
    }
  });
  for (const key of ['client-id','password']) byId(`mqtt-${key}-mode`).addEventListener('change', () => mqttSecretMode(key));
  byId('mqtt-settings').addEventListener('submit', async event => {
    event.preventDefault();
    const mqttForm = byId('mqtt-settings'), mqttResult = byId('mqtt-result');
    const notify = (text, state = '') => { mqttResult.textContent = text; mqttResult.className = state; };
    if (mqttSaving || !mqttLoaded || !mqttForm.reportValidity()) return;
    const clientMode = byId('mqtt-client-id-mode').value, passwordMode = byId('mqtt-password-mode').value;
    const values = {enabled:byId('mqtt-enabled').value, host:byId('mqtt-host').value, port:byId('mqtt-port').value,
      tls:byId('mqtt-tls').value, topic:byId('mqtt-topic').value, username:byId('mqtt-username').value,
      client_id_mode:clientMode, client_id:clientMode === 'replace' ? byId('mqtt-client-id').value : '',
      password_mode:passwordMode, password:passwordMode === 'replace' ? byId('mqtt-password').value : ''};
    for (const key of ['topic','username','client_id','password']) {
      if (new TextEncoder().encode(values[key]).length > 64) { notify('主题、用户名及凭据各最多 64 字节。', 'error'); return; }
    }
    const body = new URLSearchParams(values);
    mqttSaving = true; byId('mqtt-fields').disabled = true; byId('mqtt-save').textContent = '正在保存…';
    notify('正在保存消息设置。');
    try {
      await request('/api/mqtt', {method:'POST', headers:{'Content-Type':'application/x-www-form-urlencoded','X-CSRF-Token':csrf}, body});
      // Clear secrets immediately; the next status read reloads canonical settings.
      byId('mqtt-client-id').value = ''; byId('mqtt-password').value = '';
      mqttLoaded = false;
      notify('已保存，消息连接将自动更新。连接状态以设备反馈为准。', 'success');
      try { showState(await request('/api/state')); }
      catch (_) { notify('已保存，但暂时无法刷新设备状态；稍后会自动重试。', 'success'); }
    } catch (error) {
      notify(error.name === 'AbortError' ? '未收到保存结果，请刷新页面核对消息配置后再操作。' : error.message, 'error');
    } finally {
      mqttSaving = false; byId('mqtt-fields').disabled = !mqttWritable || !mqttLoaded;
      byId('mqtt-save').textContent = '保存消息设置 ↗';
    }
  });
  byId('rotation-settings').addEventListener('submit', async event => {
    event.preventDefault();
    const rotationForm = byId('rotation-settings'), rotationResult = byId('rotation-result');
    const notify = (text, state = '') => { rotationResult.textContent = text; rotationResult.className = state; };
    if (rotationSaving || !rotationLoaded || !rotationForm.reportValidity()) return;
    let pages = 0;
    for (const [index, page] of contentPages.entries()) if (byId(`page-${page}`).checked) pages |= 1 << (index + 1);
    if (!pages) { notify('请至少选择一项显示内容。', 'error'); return; }
    const body = new URLSearchParams({pages:String(pages),hold:byId('rotation-hold').value});
    rotationSaving = true; byId('rotation-fields').disabled = true; byId('rotation-save').textContent = '正在保存…';
    notify('正在保存轮播设置。');
    try {
      await request('/api/rotation', {method:'POST',headers:{'Content-Type':'application/x-www-form-urlencoded','X-CSRF-Token':csrf},body});
      rotationLoaded = false;
      notify('已保存。普通显示将从所选第一项开始轮播。', 'success');
      try { showState(await request('/api/state')); }
      catch (_) { notify('已保存，但暂时无法刷新设备状态；稍后会自动重试。', 'success'); }
    } catch (error) {
      notify(error.name === 'AbortError' ? '未收到保存结果，请刷新页面核对轮播设置后再操作。' : error.message, 'error');
    } finally {
      rotationSaving = false; byId('rotation-fields').disabled = !rotationWritable || !rotationLoaded;
      byId('rotation-save').textContent = '保存轮播设置 ↗';
    }
  });
  function weatherSecretMode(key) {
    const replacing = byId(`weather-${key}-mode`).value === 'replace';
    byId(`weather-${key}-field`).hidden = !replacing;
    byId(`weather-${key}`).disabled = !replacing;
    byId(`weather-${key}`).required = replacing;
  }
  function showWeather(state) {
    weatherWritable = Boolean(state.storageReady);
    if (!weatherLoaded && state.weather) {
      const settings = state.weather;
      byId('weather-enabled').value = settings.enabled ? '1' : '0';
      byId('weather-location').value = settings.location;
      byId('weather-refresh').value = String(settings.refreshMinutes);
      for (const [key, set] of [['public',settings.publicKeySet],['private',settings.privateKeySet]]) {
        byId(`weather-${key}`).value = '';
        byId(`weather-${key}-mode`).value = set ? 'keep' : 'clear';
        byId(`weather-${key}-note`).textContent = set ? '已保存，不回显。' : '尚未保存。';
        weatherSecretMode(key);
      }
      weatherLoaded = true;
    }
    if (!weatherSaving) byId('weather-fields').disabled = !weatherWritable || !weatherLoaded;
    const outdoor = state.outdoor || {};
    const indoorValid = Number.isFinite(state.temperature), outdoorValid = Number.isFinite(outdoor.temperature);
    byId('indoor-comparison').textContent = indoorValid ? `${state.temperature.toFixed(1)}°C${state.sampleFresh ? '' : ' · 旧'}` : '—';
    byId('outdoor-temperature').textContent = outdoorValid ? `${outdoor.temperature.toFixed(1)}°C${outdoor.fresh ? '' : ' · 旧'}` : '—';
    byId('indoor-comparison-humidity').textContent = Number.isFinite(state.humidity) ? `湿度 ${state.humidity.toFixed(1)}%` : '湿度不可用';
    byId('outdoor-comparison-humidity').textContent = Number.isFinite(outdoor.humidity) ? `湿度 ${outdoor.humidity.toFixed(1)}%` : '湿度未提供';
    const labels = {disabled:'天气未配置',waiting_wifi:'等待 Wi-Fi',waiting_time:'等待校时后签名请求',fetching:'正在更新天气',online:'天气已更新',retrying:'天气请求失败，稍后重试',invalid_response:'天气返回数据无效，请核对 V3 产品权限和城市',auth_error:'天气鉴权失败，请核对公私钥和产品权限',rate_limited:'访问频率受限，稍后重试',unavailable:'天气服务不可用'};
    const errors = {AP010001:'天气请求参数错误',AP010002:'天气接口无访问权限',AP010003:'天气密钥错误',AP010004:'天气签名错误',AP010005:'天气接口不存在',AP010006:'该地点无访问权限',AP010010:'找不到天气地点，请使用城市拼音或纬度:经度',AP010011:'无法通过 IP 定位城市',AP010012:'天气服务已过期',AP010013:'天气访问余额不足',AP010014:'天气访问频率受限',AP100001:'该地点暂缺天气数据'};
    const detail = errors[outdoor.errorCode] || labels[outdoor.state] || '天气未配置';
    const diagnostic = outdoor.state !== 'online' && outdoor.httpStatus > 0 ? ` · HTTP ${outdoor.httpStatus}${outdoor.errorCode ? ` / ${outdoor.errorCode}` : ''}` : '';
    byId('weather-status').textContent = detail + diagnostic + (outdoorValid && !outdoor.fresh ? ' · 数据已过期' : '');
    const humidity = Number.isFinite(outdoor.humidity) ? `${outdoor.humidity.toFixed(1)}%` : '接口未提供';
    byId('weather-observation').textContent = outdoorValid ? `${outdoor.city || ''} · ${outdoor.text || ''} · 室外湿度 ${humidity} · 观测时间 ${(outdoor.updated || '').replace('T',' ')}` : '等待天气数据';
  }
  for (const key of ['public','private']) byId(`weather-${key}-mode`).addEventListener('change', () => weatherSecretMode(key));
  byId('weather-settings').addEventListener('submit', async event => {
    event.preventDefault();
    const form = byId('weather-settings'), result = byId('weather-result');
    const notify = (text, state = '') => { result.textContent = text; result.className = state; };
    if (weatherSaving || !weatherLoaded || !weatherWritable || !form.reportValidity()) return;
    const values = {enabled:byId('weather-enabled').value, location:byId('weather-location').value.trim(), refresh:byId('weather-refresh').value};
    for (const key of ['public','private']) {
      const mode = byId(`weather-${key}-mode`).value;
      values[`${key}_mode`] = mode;
      values[`${key}_key`] = mode === 'replace' ? byId(`weather-${key}`).value.trim() : '';
    }
    if (new TextEncoder().encode(values.location).length > 64) { notify('城市最多 64 字节。','error'); return; }
    weatherSaving = true; byId('weather-fields').disabled = true; byId('weather-save').textContent = '正在保存…';
    try {
      await request('/api/weather', {method:'POST',headers:{'Content-Type':'application/x-www-form-urlencoded','X-CSRF-Token':csrf},body:new URLSearchParams(values)});
      byId('weather-public').value = ''; byId('weather-private').value = ''; weatherLoaded = false;
      notify('已保存，设备将自动获取天气；请在轮播中选择室内外对比。','success');
      try { showState(await request('/api/state')); } catch (_) { notify('已保存，稍后自动刷新状态。','success'); }
    } catch (error) { notify(error.name === 'AbortError' ? '未收到保存结果，请刷新核对后重试。' : error.message,'error'); }
    finally { weatherSaving = false; byId('weather-fields').disabled = !weatherWritable || !weatherLoaded; byId('weather-save').textContent = '保存天气设置 ↗'; }
  });
  poll();
})();
)VFDWEB";
}
